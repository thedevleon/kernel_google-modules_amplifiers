## zephyr/drivers/haptic/Kconfig
```kconfig
# SPDX-License-Identifier: Apache-2.0
# Copyright (c) 2024 Cirrus Logic, Inc.

config CS40L26
	bool "Cirrus Logic CS40L26 Haptic Driver"
	depends on SPI
	help
	  Enable driver for CS40L26 Boosted Haptic Amplifier with
	  Integrated DSP and Waveform Memory.

if CS40L26

config CS40L26_INIT_PRIORITY
	int "CS40L26 initialization priority"
	default 80
	help
	  CS40L26 device driver initialization priority.
	  Must be initialized after SPI.

module = CS40L26
module-str = cs40l26
source "subsys/logging/Kconfig.template.log_config"

endif # CS40L26
```

## zephyr/dts/bindings/haptic/cirrus,cs40l26.yaml
```yaml
# SPDX-License-Identifier: Apache-2.0
# Copyright (c) 2024 Cirrus Logic, Inc.

description: Cirrus Logic CS40L26 Boosted Haptic Amplifier

compatible: "cirrus,cs40l26"

include: [spi-device.yaml]

properties:
  reset-gpios:
    type: phandle-array
    description: Reset GPIO pin
    
  irq-gpios:
    type: phandle-array
    description: Interrupt GPIO pin
    
  devid:
    type: int
    description: Device ID (0x40A260 for CS40L26A, 0x40A26B for CS40L26B)
    default: 0x40A260
```
